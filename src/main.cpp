#include <Arduino.h>
#include <WiFi.h>
#include <Adafruit_BusIO_Register.h>
#include <Wire.h>
#include <Adafruit_SSD1306.h>
#include <Adafruit_GFX.h>
#include <HTTPClient.h>
#include <ArduinoJson.h>
#include <string.h>

const int sdaWire = 21;
const int sclWire = 22;

const int displayWidth = 128;
const int displayHeight = 64;

JsonDocument doc;

typedef struct {
	char *date;
	char *time;
} dateTime_t;

const uint8_t logo[] PROGMEM = {
	0x00, 0x00, 0x00, 0x00, 0x00, 0x00, 0x00, 0x00, 0x00, 0x00, 0x00, 0x00, 0x00, 0x00, 0x00, 0x00,
	0x00, 0x00, 0x00, 0x00, 0x00, 0x01, 0xff, 0xff, 0xff, 0xfc, 0x00, 0x00, 0x00, 0x00, 0x00, 0x00,
	0x00, 0x00, 0x00, 0x00, 0x00, 0x7f, 0xfe, 0x00, 0x03, 0xff, 0xe0, 0x00, 0x00, 0x00, 0x00, 0x00,
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	0x00, 0x00, 0x00, 0x00, 0x00, 0x00, 0x00, 0x00, 0x00, 0x06, 0x00, 0x00, 0x00, 0x00, 0x00, 0x00};

Adafruit_SSD1306 display(displayWidth, displayHeight, &Wire, -1);
HTTPClient connection;
WiFiClientSecure client;

void wifiConnect();
void drawLogo();
void onWifiConnect(WiFiEvent_t wifiEvent, WiFiEventInfo_t wifiEventInfo);
dateTime_t fetchDateTime();
void updateScreenWithDateTime(dateTime_t);
void connectClient();

void setup(){
	Serial.begin(115200);

	if (!Wire.begin(sdaWire, sclWire))
	{
		Serial.println("Failed to initialized I2C wire connection");
		for (;;)
			;
	}

	if (!display.begin(SSD1306_SWITCHCAPVCC, 0x3C))
	{
		Serial.println("Failed to initialized display");
		for (;;)
			;
	}

	drawLogo();

	delay(500);

	display.clearDisplay();

	wifiConnect();

	WiFi.onEvent(onWifiConnect, ARDUINO_EVENT_WIFI_STA_CONNECTED);

	delay(1000);

	client.setInsecure();
	
	connectClient();
}

void loop() {
	dateTime_t dateTime = fetchDateTime();
	updateScreenWithDateTime(dateTime);
	delay(900);
}

void connectClient() {
	Serial.println("Starting http client...");

	if (!connection.begin(client, "https://timeapi.io/api/time/current/zone?timeZone=America/Recife"))
	{
		Serial.println("Failed to connect to client!");
		for (;;)
			;
	}
}

void onWifiConnect(WiFiEvent_t wifiEvent, WiFiEventInfo_t wifiEventInfo){
	display.clearDisplay();
	Serial.println("Wifi connected!");
	display.setTextSize(1, 2);
	display.setTextColor(SSD1306_WHITE);
	display.setCursor(20, 25);
	display.print(F("Wifi Connected!"));
	display.display();
}

void wifiConnect(){
	// Connecting to wokwi network
	WiFi.begin("Wokwi-GUEST");
	Serial.println("Connecting to wifi");
	display.setTextSize(1, 2);
	display.setTextColor(SSD1306_WHITE);
	display.setCursor(4, 25);
	display.print(F("Connecting to Wifi"));
	display.display();

	while (WiFi.status() != WL_CONNECTED) {
  		delay(500);
  		Serial.print(".");
	}

	
	Serial.println();
	Serial.print("IP: "); Serial.println(WiFi.localIP());
	Serial.print("DNS: "); Serial.println(WiFi.dnsIP());

	IPAddress resolved;
	if (!WiFi.hostByName("timeapi.io", resolved)) {
	  Serial.println("Falha DNS para timeapi.io");
	} else {
	  Serial.print("timeapi.io -> "); Serial.println(resolved);
	}

}

void drawLogo(){
	display.clearDisplay();
	display.drawBitmap(0, 0, logo, 128, 64, SSD1306_WHITE);
	display.display();
}

dateTime_t fetchDateTime() {

	dateTime_t newDateTime;

	Serial.println("Sending request via client...");

	
	int responseCode = connection.GET();

	if (responseCode == HTTP_CODE_OK)
	{
		Serial.println("Request succesful!");
		Serial.println("Deserializing JSON...");
		DeserializationError error = deserializeJson(doc, connection.getString());

		if (error)
		{
			Serial.println("Failed to deserialize JSON");
			return {nullptr, nullptr};
		}

		const char *date = doc["date"];
		const char *time = doc["time"];

		newDateTime.date = (char *)date;
		newDateTime.time = (char *)time;

		Serial.println(newDateTime.date);
		Serial.println(newDateTime.time);
		return newDateTime;	
	} else {
		Serial.print("Erro ");
		Serial.println(responseCode);
	}

	return {nullptr, nullptr};
}

void updateScreenWithDateTime(dateTime_t dateTime) {
	display.clearDisplay();

	Serial.print("Date: ");
	Serial.println(dateTime.date);

	Serial.print("Hour: ");
	Serial.println(dateTime.time);

	display.setCursor(50, 15);
	display.setTextSize(1,2);
	display.setTextColor(SSD1306_WHITE);
	display.print(dateTime.time);

	display.setCursor(35, 35);
	display.setTextSize(1,2);
	display.setTextColor(SSD1306_WHITE);
	display.print(dateTime.date);

	display.display();
}